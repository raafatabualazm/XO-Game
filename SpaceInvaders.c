// SpaceInvaders.c
// Runs on LM4F120/TM4C123
// Jonathan Valvano and Daniel Valvano
// This is a starter project for the edX Lab 15
// In order for other students to play your game
// 1) You must leave the hardware configuration as defined
// 2) You must not add/remove any files from the project
// 3) You must add your code only this this C file
// I.e., if you wish to use code from sprite.c or sound.c, move that code in this file
// 4) It must compile with the 32k limit of the free Keil

// This virtual Nokia project only runs on the real board, this project cannot be simulated
// Instead of having a real Nokia, this driver sends Nokia
//   commands out the UART to TExaSdisplay
// The Nokia5110 is 48x84 black and white
// pixel LCD to display text, images, or other information.

// April 19, 2014
// http://www.spaceinvaders.de/
// sounds at http://www.classicgaming.cc/classics/spaceinvaders/sounds.php
// http://www.classicgaming.cc/classics/spaceinvaders/playguide.php
/* This example accompanies the books
   "Embedded Systems: Real Time Interfacing to Arm Cortex M Microcontrollers",
   ISBN: 978-1463590154, Jonathan Valvano, copyright (c) 2013

   "Embedded Systems: Introduction to Arm Cortex M Microcontrollers",
   ISBN: 978-1469998749, Jonathan Valvano, copyright (c) 2013

 Copyright 2014 by Jonathan W. Valvano, valvano@mail.utexas.edu
    You may use, edit, run or distribute this file
    as long as the above copyright notice remains
 THIS SOFTWARE IS PROVIDED "AS IS".  NO WARRANTIES, WHETHER EXPRESS, IMPLIED
 OR STATUTORY, INCLUDING, BUT NOT LIMITED TO, IMPLIED WARRANTIES OF
 MERCHANTABILITY AND FITNESS FOR A PARTICULAR PURPOSE APPLY TO THIS SOFTWARE.
 VALVANO SHALL NOT, IN ANY CIRCUMSTANCES, BE LIABLE FOR SPECIAL, INCIDENTAL,
 OR CONSEQUENTIAL DAMAGES, FOR ANY REASON WHATSOEVER.
 For more information about my classes, my research, and my books, see
 http://users.ece.utexas.edu/~valvano/
 */
// ******* Required Hardware I/O connections*******************
// PA1, PA0 UART0 connected to PC through USB cable
// Slide pot pin 1 connected to ground
// Slide pot pin 2 connected to PE2/AIN1
// Slide pot pin 3 connected to +3.3V 
// fire button connected to PE0
// special weapon fire button connected to PE1
// 8*R resistor DAC bit 0 on PB0 (least significant bit)
// 4*R resistor DAC bit 1 on PB1
// 2*R resistor DAC bit 2 on PB2
// 1*R resistor DAC bit 3 on PB3 (most significant bit)
// LED on PB4
// LED on PB5

#include "tm4c123gh6pm.h"
#include "Nokia5110.h"
#include "Random.h"
#include "TExaS.h"

void DisableInterrupts(void); // Disable interrupts
void EnableInterrupts(void);  // Enable interrupts
void Timer2_Init(unsigned long period);
void Delay100ms(unsigned long count); // time delay in 0.1 seconds


// *************************** Images ***************************
// enemy ship that starts at the top of the screen (arms/mouth closed)
// width=16 x height=10
// image of the player's ship
// includes two blacked out columns on the left and right sides of the image to prevent smearing when moved 2 pixels to the left or right
// width=18 x height=8
const unsigned char Background[] = {
 0x42, 0x4D, 0xF6, 0x04, 0x00, 0x00, 0x00, 0x00, 0x00, 0x00, 0x76, 0x00, 0x00, 0x00, 0x28, 0x00, 0x00, 0x00, 0x30, 0x00, 0x00, 0x00, 0x30, 0x00, 0x00, 0x00, 0x01, 0x00, 0x04, 0x00, 0x00, 0x00,
 0x00, 0x00, 0x80, 0x04, 0x00, 0x00, 0xD7, 0x0D, 0x00, 0x00, 0xD7, 0x0D, 0x00, 0x00, 0x00, 0x00, 0x00, 0x00, 0x00, 0x00, 0x00, 0x00, 0x00, 0x00, 0x00, 0x00, 0x00, 0x00, 0x80, 0x00, 0x00, 0x80,
 0x00, 0x00, 0x00, 0x80, 0x80, 0x00, 0x80, 0x00, 0x00, 0x00, 0x80, 0x00, 0x80, 0x00, 0x80, 0x80, 0x00, 0x00, 0x80, 0x80, 0x80, 0x00, 0xC0, 0xC0, 0xC0, 0x00, 0x00, 0x00, 0xFF, 0x00, 0x00, 0xFF,
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 0xFF, 0xFF, 0xFF, 0xFF, 0xFF, 0xFF, 0x0F, 0xFF, 0xFF, 0xFF, 0xFF, 0xFF, 0xFF, 0xFF, 0x0F, 0xFF, 0xFF, 0xFF, 0xFF, 0xFF, 0xFF, 0xFF, 0xFF,
 
};
const unsigned char X[] ={
 0x42, 0x4D, 0xD6, 0x00, 0x00, 0x00, 0x00, 0x00, 0x00, 0x00, 0x76, 0x00, 0x00, 0x00, 0x28, 0x00, 0x00, 0x00, 0x0C, 0x00, 0x00, 0x00, 0x0C, 0x00, 0x00, 0x00, 0x01, 0x00, 0x04, 0x00, 0x00, 0x00,
 0x00, 0x00, 0x60, 0x00, 0x00, 0x00, 0xD7, 0x0D, 0x00, 0x00, 0xD7, 0x0D, 0x00, 0x00, 0x00, 0x00, 0x00, 0x00, 0x00, 0x00, 0x00, 0x00, 0x00, 0x00, 0x00, 0x00, 0x00, 0x00, 0x80, 0x00, 0x00, 0x80,
 0x00, 0x00, 0x00, 0x80, 0x80, 0x00, 0x80, 0x00, 0x00, 0x00, 0x80, 0x00, 0x80, 0x00, 0x80, 0x80, 0x00, 0x00, 0x80, 0x80, 0x80, 0x00, 0xC0, 0xC0, 0xC0, 0x00, 0x00, 0x00, 0xFF, 0x00, 0x00, 0xFF,
 0x00, 0x00, 0x00, 0xFF, 0xFF, 0x00, 0xFF, 0x00, 0x00, 0x00, 0xFF, 0x00, 0xFF, 0x00, 0xFF, 0xFF, 0x00, 0x00, 0xFF, 0xFF, 0xFF, 0x00, 0x70, 0x00, 0x8F, 0xF0, 0x00, 0x07, 0x00, 0x00, 0x70, 0x00,
 0x7F, 0x70, 0x00, 0x00, 0x00, 0x00, 0x00, 0x00, 0x07, 0x00, 0x00, 0x00, 0x00, 0x00, 0x70, 0x00, 0x00, 0x00, 0x00, 0x07, 0x00, 0x00, 0xFF, 0x00, 0x00, 0x00, 0x00, 0x8F, 0x00, 0x00, 0xFF, 0x80,
 0x00, 0x00, 0x07, 0xFF, 0x00, 0x00, 0xFF, 0x00, 0x00, 0x00, 0x08, 0xFF, 0x00, 0x00, 0xF7, 0x00, 0x00, 0x00, 0x07, 0x8F, 0x00, 0x00, 0x70, 0x00, 0x00, 0x00, 0x00, 0x08, 0x00, 0x00, 0x00, 0x00,
 0x07, 0x80, 0x00, 0x07, 0x00, 0x00, 0x00, 0x00, 0x08, 0xF7, 0x00, 0x07, 0x00, 0x00, 0x77, 0x77, 0x7F, 0xF8, 0x77, 0x78, 0x00, 0x00, 0xFF,

};
const unsigned char O[] ={
 0x42, 0x4D, 0xD6, 0x00, 0x00, 0x00, 0x00, 0x00, 0x00, 0x00, 0x76, 0x00, 0x00, 0x00, 0x28, 0x00, 0x00, 0x00, 0x0C, 0x00, 0x00, 0x00, 0x0C, 0x00, 0x00, 0x00, 0x01, 0x00, 0x04, 0x00, 0x00, 0x00,
 0x00, 0x00, 0x60, 0x00, 0x00, 0x00, 0xD7, 0x0D, 0x00, 0x00, 0xD7, 0x0D, 0x00, 0x00, 0x00, 0x00, 0x00, 0x00, 0x00, 0x00, 0x00, 0x00, 0x00, 0x00, 0x00, 0x00, 0x00, 0x00, 0x80, 0x00, 0x00, 0x80,
 0x00, 0x00, 0x00, 0x80, 0x80, 0x00, 0x80, 0x00, 0x00, 0x00, 0x80, 0x00, 0x80, 0x00, 0x80, 0x80, 0x00, 0x00, 0x80, 0x80, 0x80, 0x00, 0xC0, 0xC0, 0xC0, 0x00, 0x00, 0x00, 0xFF, 0x00, 0x00, 0xFF,
 0x00, 0x00, 0x00, 0xFF, 0xFF, 0x00, 0xFF, 0x00, 0x00, 0x00, 0xFF, 0x00, 0xFF, 0x00, 0xFF, 0xFF, 0x00, 0x00, 0xFF, 0xFF, 0xFF, 0x00, 0xFF, 0xF7, 0x70, 0x07, 0x7F, 0xFF, 0x00, 0x00, 0xF8, 0x00,
 0x00, 0x00, 0x00, 0x8F, 0x00, 0x00, 0xF0, 0x00, 0x00, 0x00, 0x00, 0x0F, 0x00, 0x00, 0x70, 0x00, 0x07, 0x70, 0x00, 0x07, 0x00, 0x00, 0x00, 0x00, 0x7F, 0xF7, 0x00, 0x00, 0x00, 0x00, 0x00, 0x00,
 0x7F, 0xF7, 0x00, 0x00, 0x00, 0x00, 0x00, 0x00, 0x7F, 0xF7, 0x00, 0x00, 0x00, 0x00, 0x00, 0x00, 0x7F, 0xF0, 0x00, 0x07, 0x00, 0x00, 0x70, 0x00, 0x07, 0x70, 0x00, 0x07, 0x00, 0x00, 0xF0, 0x00,
 0x00, 0x00, 0x00, 0x7F, 0x00, 0x00, 0xFF, 0x00, 0x00, 0x00, 0x07, 0xFF, 0x00, 0x00, 0xFF, 0xF8, 0x77, 0x77, 0x8F, 0xFF, 0x00, 0x00, 0xFF,

};


const unsigned char pointer[] ={
 0x42, 0x4D, 0xD6, 0x00, 0x00, 0x00, 0x00, 0x00, 0x00, 0x00, 0x76, 0x00, 0x00, 0x00, 0x28, 0x00, 0x00, 0x00, 0x0C, 0x00, 0x00, 0x00, 0x0C, 0x00, 0x00, 0x00, 0x01, 0x00, 0x04, 0x00, 0x00, 0x00,
 0x00, 0x00, 0x60, 0x00, 0x00, 0x00, 0xD7, 0x0D, 0x00, 0x00, 0xD7, 0x0D, 0x00, 0x00, 0x00, 0x00, 0x00, 0x00, 0x00, 0x00, 0x00, 0x00, 0x00, 0x00, 0x00, 0x00, 0x00, 0x00, 0x80, 0x00, 0x00, 0x80,
 0x00, 0x00, 0x00, 0x80, 0x80, 0x00, 0x80, 0x00, 0x00, 0x00, 0x80, 0x00, 0x80, 0x00, 0x80, 0x80, 0x00, 0x00, 0x80, 0x80, 0x80, 0x00, 0xC0, 0xC0, 0xC0, 0x00, 0x00, 0x00, 0xFF, 0x00, 0x00, 0xFF,
 0x00, 0x00, 0x00, 0xFF, 0xFF, 0x00, 0xFF, 0x00, 0x00, 0x00, 0xFF, 0x00, 0xFF, 0x00, 0xFF, 0xFF, 0x00, 0x00, 0xFF, 0xFF, 0xFF, 0x00, 0x00, 0x00, 0x00, 0x00, 0x00, 0x00, 0x00, 0x00, 0x00, 0x00,
 0x00, 0x00, 0x00, 0x00, 0x00, 0x00, 0x00, 0x00, 0x00, 0x00, 0x00, 0x00, 0x00, 0x00, 0x00, 0x00, 0x00, 0x00, 0x00, 0x00, 0x00, 0x00, 0x00, 0x00, 0x00, 0x00, 0x00, 0x00, 0x00, 0x00, 0x00, 0x00,
 0x00, 0x00, 0x00, 0x00, 0x00, 0x00, 0x00, 0x00, 0x00, 0x00, 0x00, 0x00, 0x00, 0x00, 0x00, 0x00, 0x00, 0x00, 0x00, 0x00, 0x00, 0x00, 0x00, 0x00, 0x00, 0x00, 0x00, 0x00, 0x00, 0x00, 0x00, 0x00,
 0x00, 0x00, 0x00, 0x00, 0x00, 0x00, 0x00, 0x00, 0x00, 0x00, 0x00, 0x00, 0x00, 0x00, 0x00, 0x00, 0x00, 0x00, 0x00, 0x00, 0x00, 0x00, 0xFF,
};

const unsigned char pointerErase[] ={
 0x42, 0x4D, 0xD6, 0x00, 0x00, 0x00, 0x00, 0x00, 0x00, 0x00, 0x76, 0x00, 0x00, 0x00, 0x28, 0x00, 0x00, 0x00, 0x0C, 0x00, 0x00, 0x00, 0x0C, 0x00, 0x00, 0x00, 0x01, 0x00, 0x04, 0x00, 0x00, 0x00,
 0x00, 0x00, 0x60, 0x00, 0x00, 0x00, 0xD7, 0x0D, 0x00, 0x00, 0xD7, 0x0D, 0x00, 0x00, 0x00, 0x00, 0x00, 0x00, 0x00, 0x00, 0x00, 0x00, 0x00, 0x00, 0x00, 0x00, 0x00, 0x00, 0x80, 0x00, 0x00, 0x80,
 0x00, 0x00, 0x00, 0x80, 0x80, 0x00, 0x80, 0x00, 0x00, 0x00, 0x80, 0x00, 0x80, 0x00, 0x80, 0x80, 0x00, 0x00, 0x80, 0x80, 0x80, 0x00, 0xC0, 0xC0, 0xC0, 0x00, 0x00, 0x00, 0xFF, 0x00, 0x00, 0xFF,
 0x00, 0x00, 0x00, 0xFF, 0xFF, 0x00, 0xFF, 0x00, 0x00, 0x00, 0xFF, 0x00, 0xFF, 0x00, 0xFF, 0xFF, 0x00, 0x00, 0xFF, 0xFF, 0xFF, 0x00, 0xFF, 0xFF, 0xFF, 0xFF, 0xFF, 0xFF, 0x00, 0x00, 0xFF, 0xFF,
 0xFF, 0xFF, 0xFF, 0xFF, 0x00, 0x00, 0xFF, 0xFF, 0xFF, 0xFF, 0xFF, 0xFF, 0x00, 0x00, 0xFF, 0xFF, 0xFF, 0xFF, 0xFF, 0xFF, 0x00, 0x00, 0xFF, 0xFF, 0xFF, 0xFF, 0xFF, 0xFF, 0x00, 0x00, 0xFF, 0xFF,
 0xFF, 0xFF, 0xFF, 0xFF, 0x00, 0x00, 0xFF, 0xFF, 0xFF, 0xFF, 0xFF, 0xFF, 0x00, 0x00, 0xFF, 0xFF, 0xFF, 0xFF, 0xFF, 0xFF, 0x00, 0x00, 0xFF, 0xFF, 0xFF, 0xFF, 0xFF, 0xFF, 0x00, 0x00, 0xFF, 0xFF,
 0xFF, 0xFF, 0xFF, 0xFF, 0x00, 0x00, 0xFF, 0xFF, 0xFF, 0xFF, 0xFF, 0xFF, 0x00, 0x00, 0xFF, 0xFF, 0xFF, 0xFF, 0xFF, 0xFF, 0x00, 0x00, 0xFF,
};






// *************************** Capture image dimensions out of BMP**********
#define xw     ((unsigned char)X[18])
#define xh     ((unsigned char)X[22])
#define ow     ((unsigned char)O[18])
#define oh     ((unsigned char)O[22])
#define PW     ((unsigned char)pointer[18])
#define PH     ((unsigned char)pointer[22])	

unsigned long xpos = 0, ypos = 1, sum = 0, winner = 0, recx = 0, recy = 0;
unsigned char ch = 'x';
unsigned long state[3][3]; 
int i , j;
void Delay(void);
void markThisPlace(void);
void moveRight(void);
void moveLeft(void);
void moveUp(void);
void moveDown(void);
void checkForWinner(void);
void restart(void);
void checkForDraw(void);
void outRes(void);
void PortE_Init(void);
void PortF_Init(void);

int main(void){
  TExaS_Init(NoLCD_NoScope);  // set system clock to 80 MHz
  // you cannot use both the Scope and the virtual Nokia (both need UART0)
  Random_Init(1);
  Nokia5110_Init();
	PortE_Init();
	PortF_Init();
  EnableInterrupts(); // virtual Nokia uses UART0 interrupts
	//Nokia5110_OutString("x");
	Nokia5110_PrintBMP(0, 47, Background, 0);
	Nokia5110_DisplayBuffer();   // draw buffer
	outRes();
	for ( i =0;i <3;i++)
		for( j =0; j<3;j++)
			state[i][j]=0;
  while(1){
		
	}
}

void Delay(void){
	unsigned long volatile time;
  time = 100*727240*200/91;  // 0.1sec
  while(time){
		time--;
  }
}

void Delay100ms(unsigned long count){unsigned long volatile time;
  while(count>0){
    time = 1500;  // 0.1sec at 80 MHz
    while(time){
	  	time--;
    }
    count--;
  }
}

void PortE_Init(void){ volatile unsigned long delay;
  SYSCTL_RCGC2_R |= (1<<4);     		// 1) E clock
  delay = SYSCTL_RCGC2_R;           // delay
	GPIO_PORTE_DIR_R &= ~0x1F;      // 2) PE0 - PE4 input
	GPIO_PORTE_AFSEL_R &= 0x00;    // 4) no alternate function
	GPIO_PORTE_DEN_R |= 0x1F;       // 5) enable digital pins E0 - E4
	GPIO_PORTE_IM_R |= 0x1F;
	GPIO_PORTE_IS_R &= ~0x1F;
	GPIO_PORTE_IBE_R &= ~0x1F;
	GPIO_PORTE_IEV_R |= 0x1F;
	GPIO_PORTE_ICR_R |= 0x1F;
	NVIC_EN0_R |= (1<<4);
	//EnableInterrupts();
	NVIC_PRI1_R &= ~(7<<5) ;
	NVIC_PRI1_R |= (5<<5) ;		
}

void GPIOPortE_Handler(){
	if(GPIO_PORTE_RIS_R & (1<<0))
	{
		GPIO_PORTE_ICR_R |= (1<<0);
		markThisPlace();
	}
	else if(GPIO_PORTE_RIS_R & (1<<1))
	{
		GPIO_PORTE_ICR_R |= (1<<1);
		GPIO_PORTF_DATA_R |= (1<<1);
		moveLeft();
	}
	else if(GPIO_PORTE_RIS_R & (1<<2))
	{
		GPIO_PORTE_ICR_R |= (1<<2);
		moveDown();
	}
	else if(GPIO_PORTE_RIS_R & (1<<3))
	{
		GPIO_PORTE_ICR_R |= (1<<3);
		moveRight();
	}
	else if(GPIO_PORTE_RIS_R & (1<<4))
	{
		GPIO_PORTE_ICR_R |= (1<<4);
		moveUp();
	}
	
}

void markThisPlace(){
	//if marked
	if(ch == 'x'){
		if (state[xpos][ypos-1] == 0 ){
			Nokia5110_PrintBMP(xpos*16+2, ypos*16-2, pointerErase, 0);
			Nokia5110_PrintBMP(xpos*16+2, ypos*16-2, X, 0);
			Nokia5110_DisplayBuffer();
			outRes();
			state[xpos][ypos-1]=1;
			checkForWinner();
			if(winner == 1){
				winner = 0 ;
				ch = 'x' ;
			}
			else{
				checkForDraw();
				ch='o';
			}
	}
		
	}
	else if(ch == 'o') {
		if (state[xpos][ypos-1] == 0 ){
			Nokia5110_PrintBMP(xpos*16+2, ypos*16-2, pointerErase, 0);
			Nokia5110_PrintBMP(xpos*16+2, ypos*16-2, O, 0);
			Nokia5110_DisplayBuffer();
			outRes();
			state[xpos][ypos-1]=2;
			checkForWinner();
			if(winner == 1)
				winner = 0 ;
			else
				ch='x';
		}
	}	
}

void moveRight(){ 
	if (state[xpos][ypos-1] == 0 ){
		Nokia5110_PrintBMP(xpos*16+2, ypos*16-2, pointerErase, 0);
		Nokia5110_DisplayBuffer();
		outRes();
	}
	else if(state[xpos][ypos-1] == 1){
		Nokia5110_PrintBMP(xpos*16+2, ypos*16-2, X, 0);
		Nokia5110_DisplayBuffer();
		outRes();
	}
	else{
		Nokia5110_PrintBMP(xpos*16+2, ypos*16-2, O, 0);
		Nokia5110_DisplayBuffer();
		outRes();
	}
	if(xpos < 2) ++xpos;
	Nokia5110_PrintBMP(xpos*16+2, ypos*16-2, pointer, 0);
	Nokia5110_DisplayBuffer();
	outRes();
}

void moveLeft(){
	if (state[xpos][ypos-1] == 0 ){
		Nokia5110_PrintBMP(xpos*16+2, ypos*16-2, pointerErase, 0);
		Nokia5110_DisplayBuffer();
		outRes();
	}
	else if(state[xpos][ypos-1] == 1){
		Nokia5110_PrintBMP(xpos*16+2, ypos*16-2, X, 0);
		Nokia5110_DisplayBuffer();
		outRes();
	}
	else{
		Nokia5110_PrintBMP(xpos*16+2, ypos*16-2, O, 0);
		Nokia5110_DisplayBuffer();
		outRes();
	}
	if(xpos > 0) --xpos;
	Nokia5110_PrintBMP(xpos*16+2, ypos*16-2, pointer, 0);
	Nokia5110_DisplayBuffer();
	outRes();
}

void moveUp(){
	if (state[xpos][ypos-1] == 0 ){
		Nokia5110_PrintBMP(xpos*16+2, ypos*16-2, pointerErase, 0);
		Nokia5110_DisplayBuffer();
		outRes();
	}
	else if(state[xpos][ypos-1] == 1){
		Nokia5110_PrintBMP(xpos*16+2, ypos*16-2, X, 0);
		Nokia5110_DisplayBuffer();
		outRes();
	}
	else{
		Nokia5110_PrintBMP(xpos*16+2, ypos*16-2, O, 0);
		Nokia5110_DisplayBuffer();
		outRes();
	}
	if(ypos > 1) --ypos;
	Nokia5110_PrintBMP(xpos*16+2, ypos*16-2, pointer, 0);
	Nokia5110_DisplayBuffer();
	outRes();
}

void moveDown(){ 
	if (state[xpos][ypos-1] == 0 ){
		Nokia5110_PrintBMP(xpos*16+2, ypos*16-2, pointerErase, 0);
		Nokia5110_DisplayBuffer();
		outRes();
	}
	else if(state[xpos][ypos-1] == 1){
		Nokia5110_PrintBMP(xpos*16+2, ypos*16-2, X, 0);
		Nokia5110_DisplayBuffer();
		outRes();
	}
	else{
		Nokia5110_PrintBMP(xpos*16+2, ypos*16-2, O, 0);
		Nokia5110_DisplayBuffer();
		outRes();
	}
	if(ypos < 3) ++ypos;
	Nokia5110_PrintBMP(xpos*16+2, ypos*16-2, pointer, 0);
	Nokia5110_DisplayBuffer();
	outRes();
}

void checkForWinner(){
	int z, row = xpos, col = ypos - 1 ;
	if(ch == 'x')	z = 1 ;
	else	z = 2 ;
	//check for this column
	sum = 0 ;
	for(i = 0 ; i < 3 ; ++i){
		if(state[row][i] == z)++sum ;
	}
	if(sum == 3)	//there's a winner	
		restart();
	//check for this row
	sum = 0 ;
	for(i = 0 ; i < 3 ; ++i){
		if(state[i][col] == z)++sum ;
	}
	if(sum == 3)	//there's a winner
		restart();
	if(state[0][0] == z && state[1][1] == z && state[2][2] == z)	//there's a winner
		restart();
	if(state[0][2] == z && state[1][1] == z && state[2][0] == z)	//there's a winner
		restart();
}

void restart(void){
	winner = 1 ;
	if(ch == 'x')	++recx;
	else	++recy;
	Nokia5110_ClearBuffer();
	Nokia5110_DisplayBuffer();
	Nokia5110_OutChar(ch) ;
	Nokia5110_OutString(" have won the game!");
	Delay();
	Nokia5110_ClearBuffer();
	Nokia5110_PrintBMP(0, 47, Background, 0);
	Nokia5110_DisplayBuffer();   // draw buffer
	outRes();
	for ( i =0;i <3;i++)
		for( j =0; j<3;j++)
			state[i][j]=0;
}

void checkForDraw(){
	int z = 0 ;
	for(i = 0 ; i < 3 ; ++i){
		for(j = 0 ; j < 3 ; ++j){
			if(state[i][j] == 0)
				z = 1 ;
		}
	}
	if(z == 0){		//there's a draw
		winner = 0 ;
		Nokia5110_ClearBuffer();
		Nokia5110_DisplayBuffer();
		Nokia5110_OutString("No one have won the game!");
		Delay();
		Nokia5110_ClearBuffer();
		Nokia5110_PrintBMP(0, 47, Background, 0);
		Nokia5110_DisplayBuffer();   // draw buffer
		outRes();
		for ( i =0;i <3;i++)
			for( j =0; j<3;j++)
				state[i][j]=0;
		}
}

void outRes(){
	Nokia5110_SetCursor(7, 0);
	Nokia5110_OutString("Res");
	Nokia5110_SetCursor(7, 1);
	Nokia5110_OutString("X: ");
	Nokia5110_SetCursor(10, 1);
	Nokia5110_OutChar('0'+recx);
	Nokia5110_SetCursor(7, 2);
	Nokia5110_OutString("Y: ");
	Nokia5110_SetCursor(10, 2);
	Nokia5110_OutChar('0'+recy);
}

void PortF_Init(void){ volatile unsigned long delay;
  SYSCTL_RCGC2_R |= 0x00000020;     // 1) F clock
  delay = SYSCTL_RCGC2_R;           // delay   
  GPIO_PORTF_LOCK_R = 0x4C4F434B;   // 2) unlock PortF PF0  
  GPIO_PORTF_CR_R = 0x1F;           // allow changes to PF4-0       
  GPIO_PORTF_AMSEL_R = 0x00;        // 3) disable analog function
  GPIO_PORTF_PCTL_R = 0x00000000;   // 4) GPIO clear bit PCTL  
  GPIO_PORTF_DIR_R = 0x0E;          // 5) PF4,PF0 input, PF3,PF2,PF1 output   
  GPIO_PORTF_AFSEL_R = 0x00;        // 6) no alternate function
  GPIO_PORTF_PUR_R = 0x11;          // enable pullup resistors on PF4,PF0       
  GPIO_PORTF_DEN_R = 0x1F;          // 7) enable digital pins PF4-PF0 
}
